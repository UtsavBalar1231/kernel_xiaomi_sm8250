/dts-v1/;

#include "sdm429.dtsi"
#include "sdm429-cdp.dtsi"

/ {
	model = "Qualcomm Technologies, Inc. SDM429 CDP";
	compatible = "qcom,sdm429-cdp", "qcom,sdm429", "qcom,cdp";
	qcom,board-id = <1 3>;
	qcom,pmic-id = <0x010016 0x25 0x0 0x0>;
};

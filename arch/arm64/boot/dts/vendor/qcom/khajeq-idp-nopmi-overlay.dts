/dts-v1/;
/plugin/;

#include <dt-bindings/interrupt-controller/arm-gic.h>
#include "khajeq-idp-nopmi.dtsi"

/ {
	model = "Qualcomm Technologies, Inc. KHAJEQ IDP nopmi";
	compatible = "qcom,khajeq-idp", "qcom,khajeq", "qcom,idp";
	qcom,msm-id = <562 0x10000>;
	qcom,board-id = <0x10022 0>;
	qcom,pmic-id = <0x2D 0x0 0x0 0x0>;
};

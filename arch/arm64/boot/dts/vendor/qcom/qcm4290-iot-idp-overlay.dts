/dts-v1/;
/plugin/;

#include <dt-bindings/interrupt-controller/arm-gic.h>
#include "qcm4290-iot-idp.dtsi"

/ {
	model = "Qualcomm Technologies, Inc. QCM4290 IOT IDP Overlay";
	compatible = "qcom,qcm4290-idp", "qcom,qcm4290", "qcom,idp";
	qcom,msm-id = <469 0x10000>;
	qcom,board-id = <34 0>;
};

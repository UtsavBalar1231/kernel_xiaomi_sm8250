/dts-v1/;

#include "khajep.dtsi"
#include "khajep-idp-nopmi.dtsi"

/ {
	model = "Qualcomm Technologies, Inc. KHAJEP IDP nopmi";
	compatible = "qcom,khajep-idp", "qcom,khajep", "qcom,idp";
	qcom,board-id = <0x10022 0>;
	qcom,pmic-id = <0x2D 0x0 0x0 0x0>;
};

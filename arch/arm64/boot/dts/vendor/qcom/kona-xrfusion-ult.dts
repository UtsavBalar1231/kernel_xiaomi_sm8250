/dts-v1/;

#include "kona.dtsi"
#include "kona-xrfusion-ult.dtsi"

/ {
	model = "Qualcomm Technologies, Inc. kona XR 5G UltraSound";
	compatible = "qcom,kona-mtp", "qcom,kona", "qcom,mtp";
	qcom,board-id = <0x1030008 0>;
};

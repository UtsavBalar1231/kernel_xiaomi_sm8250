/dts-v1/;

#include "sda429.dtsi"
#include "sdm429-mtp.dtsi"

/ {
	model = "Qualcomm Technologies, Inc. SDA429 MTP";
	compatible = "qcom,sda429-mtp", "qcom,sda429", "qcom,mtp";
	qcom,board-id = <8 2>;
	qcom,pmic-id = <0x010016 0x25 0x0 0x0>;
};

/dts-v1/;

#include "scuba-iot-low-ram.dtsi"
#include "scuba-iot-qcs.dtsi"

/ {
	model = "Qualcomm Technologies, Inc. Scubap IOT 2GB DDR SoC";
	compatible = "qcom,scuba-iot";
	qcom,msm-id = <474 0x10000>;
	qcom,board-id = <0 0x400>;
};

/dts-v1/;

#include "orchid.dtsi"
#include "orchid-mtp.dtsi"
#include "lito-v2-audio.dtsi"

/ {
	model = "Qualcomm Technologies, Inc. Orchid MTP";
	compatible = "qcom,orchid-mtp", "qcom,orchid", "qcom,mtp";
	qcom,board-id = <8 0>;
};

&ufsphy_mem {
	/delete-property/ vdda-phy-always-on;
};

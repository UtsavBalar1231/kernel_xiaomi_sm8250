/dts-v1/;

#include "msm8937-interposer-sdm429.dtsi"
#include "sdm429-cdp.dtsi"

/ {
	model = "Qualcomm Technologies, Inc. MSM8937 Interposer SDM429 CDP";
	compatible = "qcom,msm8937-cdp", "qcom,msm8937", "qcom,cdp";
	qcom,board-id = <1 3>;
	qcom,pmic-id = <0x010016 0x25 0x0 0x0>;
};

/dts-v1/;

#include "msm8937-interposer-sdm439.dtsi"
#include "sdm439-qrd.dtsi"

/ {
	model = "Qualcomm Technologies, Inc. MSM8937 Interposer SDM439 QRD";
	compatible = "qcom,msm8937-qrd", "qcom,msm8937", "qcom,qrd";
	qcom,board-id = <0xb 2>;
	qcom,pmic-id = <0x010016 0x25 0x0 0x0>;
};

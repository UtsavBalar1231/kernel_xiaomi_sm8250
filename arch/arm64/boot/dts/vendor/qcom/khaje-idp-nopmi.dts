/dts-v1/;

#include "khaje.dtsi"
#include "khaje-idp-nopmi.dtsi"

/ {
	model = "Qualcomm Technologies, Inc. KHAJE IDP nopmi";
	compatible = "qcom,khaje-idp", "qcom,khaje", "qcom,idp";
	qcom,board-id = <34 0>;
	qcom,pmic-id = <0x2D 0x0 0x0 0x0>;
};

/dts-v1/;
/plugin/;

#include <dt-bindings/interrupt-controller/arm-gic.h>
#include "khaje-idp-nopmi.dtsi"

/ {
	model = "Qualcomm Technologies, Inc. KHAJE IDP nopmi";
	compatible = "qcom,khaje-idp", "qcom,khaje", "qcom,idp";
	qcom,msm-id = <518 0x10000>;
	qcom,board-id = <34 0>;
	qcom,pmic-id = <0x2D 0x0 0x0 0x0>;
};

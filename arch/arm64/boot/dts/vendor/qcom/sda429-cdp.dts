/dts-v1/;

#include "sda429.dtsi"
#include "sdm429-cdp.dtsi"

/ {
	model = "Qualcomm Technologies, Inc. SDA429 CDP";
	compatible = "qcom,sda429-cdp", "qcom,sda429", "qcom,cdp";
	qcom,board-id = <1 3>;
	qcom,pmic-id = <0x010016 0x25 0x0 0x0>;
};

/dts-v1/;

#include "msm8937-interposer-sdm429.dtsi"
#include "sdm429-mtp.dtsi"

/ {
	model = "Qualcomm Technologies, Inc. MSM8937 Interposer SDM429 MTP";
	compatible = "qcom,msm8937-mtp", "qcom,msm8937", "qcom,mtp";
	qcom,board-id = <8 2>;
	qcom,pmic-id = <0x010016 0x25 0x0 0x0>;
};

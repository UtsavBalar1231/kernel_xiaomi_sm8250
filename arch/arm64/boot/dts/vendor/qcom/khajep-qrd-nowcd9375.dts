/dts-v1/;

#include "khajep.dtsi"
#include "khajep-qrd.dtsi"
#include "khaje-qrd-pm7250b.dtsi"
#include "khajep-qrd-nowcd9375.dtsi"

/ {
	model = "Qualcomm Technologies, Inc. KHAJEP QRD NOWCD9375";
	compatible = "qcom,khajep-qrd", "qcom,khajep", "qcom,qrd";
	qcom,board-id = <0x2010B 0>;
	qcom,pmic-id = <0x2D 0x2E 0x0 0x0>;
};

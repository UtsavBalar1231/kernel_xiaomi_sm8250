/dts-v1/;

#include "scuba-iot.dtsi"
#include "scuba-iot-idp.dtsi"
#include "scuba-iot-qcs.dtsi"

/ {
	model = "Qualcomm Technologies, Inc. Scubap IOT IDP";
	compatible = "qcom,scuba-idp", "qcom,scubap-iot", "qcom,idp";
	qcom,msm-id = <474 0x10000>;
	qcom,board-id = <34 0>;
};

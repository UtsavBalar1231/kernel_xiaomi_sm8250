/dts-v1/;

#include "sdm429.dtsi"
#include "sdm429-mtp.dtsi"

/ {
	model = "Qualcomm Technologies, Inc. SDM429 MTP";
	compatible = "qcom,sdm429-mtp", "qcom,sdm429", "qcom,mtp";
	qcom,board-id = <8 2>;
	qcom,pmic-id = <0x010016 0x25 0x0 0x0>;
};

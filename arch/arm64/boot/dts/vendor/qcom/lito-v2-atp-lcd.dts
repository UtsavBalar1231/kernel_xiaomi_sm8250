/dts-v1/;

#include "lito-v2.dtsi"
#include "lito-atp.dtsi"
#include "lito-v2-audio.dtsi"

/ {
	model = "Qualcomm Technologies, Inc. Lito v2 LCD ATP";
	compatible = "qcom,lito-atp", "qcom,lito", "qcom,atp";
	qcom,board-id = <33 1>;
};

&ufsphy_mem {
	/delete-property/ vdda-phy-always-on;
};

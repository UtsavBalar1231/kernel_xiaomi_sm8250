/dts-v1/;
/plugin/;

#include "bengal-qrd.dtsi"
#include "bengal-qrd-pmi632.dtsi"
#include "bengal-thermal-pmi632-overlay.dtsi"

/ {
	model = "Qualcomm Technologies, Inc. Bengal QRD";
	compatible = "qcom,bengal-qrd", "qcom,bengal", "qcom,qrd";
	qcom,board-id = <0x1000B 0>;
};

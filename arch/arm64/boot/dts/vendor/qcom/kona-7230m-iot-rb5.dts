/dts-v1/;

#include "kona-7230-iot-v2.1.dtsi"
#include "kona-7230m-iot-rb5.dtsi"

/ {
	model = "Qualcomm Technologies, Inc. KONA-7230M IOT RB5";
	compatible = "qcom,kona-iot", "qcom,kona", "qcom,iot";
	qcom,board-id = <0x04000B 0x03>;
};

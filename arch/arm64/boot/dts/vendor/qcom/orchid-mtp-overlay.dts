/dts-v1/;
/plugin/;

#include <dt-bindings/interrupt-controller/arm-gic.h>
#include "orchid-mtp.dtsi"
#include "lito-v2-audio.dtsi"

/ {
	model = "Qualcomm Technologies, Inc. Orchid MTP";
	compatible = "qcom,orchid-mtp", "qcom,orchid", "qcom,mtp";
	qcom,msm-id = <476 0x10000>;
	qcom,board-id = <8 0>;
};

/*
 * overriding adsp-fw-names with empty string
 * to allow default adsp img load
 */
&adsp_loader {
	adsp-fw-names="";
};

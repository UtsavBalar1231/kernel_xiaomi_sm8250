/dts-v1/;

#include "sda429.dtsi"

/ {
	model = "Qualcomm Technologies, Inc. SDA429 CDP";
	compatible = "qcom,sda429-cdp", "qcom,sda429", "qcom,cdp";
	qcom,pmic-id = <0x010016 0x25 0x0 0x0>;
	qcom.pmic-name = "PMI632";
};

/dts-v1/;
/plugin/;

#include "kona-cdp-lcd.dtsi"

/ {
	model = "Qualcomm Technologies, Inc. kona CDP (LCD) tron";
	compatible = "qcom,kona-cdp", "qcom,kona", "qcom,cdp";
	qcom,board-id = <0x01020001 0>;
};

&mdm0 {
	status = "disabled";
};

/dts-v1/;

#include "msm8937-interposer-sdm439.dtsi"

/ {
	model = "Qualcomm Technologies, Inc. MSM8953 + PMI632 SOC";
	compatible = "qcom,msm8953";
	qcom,pmic-id = <0x010016 0x25 0x0 0x0>;
	qcom.pmic-name = "PMI632";
};

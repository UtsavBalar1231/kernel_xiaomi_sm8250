/dts-v1/;

#include "kona-7230-iot-v2.1.dtsi"
#include "kona-7230-iot-rb5.dtsi"

/ {
	model = "Qualcomm Technologies, Inc. kona-7230 IOT RB5";
	compatible = "qcom,kona-iot", "qcom,kona", "qcom,iot";
	qcom,board-id = <11 3>;
};

/dts-v1/;

#include "khaje.dtsi"
#include "khaje-qrd.dtsi"
#include "khaje-qrd-pm7250b.dtsi"
#include "khaje-qrd-hvdcp3p5.dtsi"

/ {
	model = "Qualcomm Technologies, Inc. KHAJE QRD HVDCP3P5";
	compatible = "qcom,khaje-qrd", "qcom,khaje", "qcom,qrd";
	qcom,board-id = <0x1010B 0>;
	qcom,pmic-id = <0x2D 0x2E 0x0 0x0>;
};

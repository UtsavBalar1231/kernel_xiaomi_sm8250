/dts-v1/;

#include "sdm439.dtsi"
#include "sdm439-mtp.dtsi"

/ {
	model = "Qualcomm Technologies, Inc. SDM439 MTP";
	compatible = "qcom,sdm439-mtp", "qcom,sdm439", "qcom,mtp";
	qcom,board-id = <8 1>;
	qcom,pmic-id = <0x010016 0x25 0x0 0x0>;
};

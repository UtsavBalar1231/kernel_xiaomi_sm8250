/dts-v1/;

#include "scuba-iot.dtsi"
#include "scuba-iot-qcs.dtsi"

/ {
	model = "Qualcomm Technologies, Inc. Scubap IOT SoC";
	compatible = "qcom,scubap-iot";
	qcom,msm-id = <474 0x10000>;
	qcom,board-id = <0 0>;
};

/dts-v1/;

#include "khajep.dtsi"
#include "khajep-idp.dtsi"
#include "khaje-idp-pm7250b.dtsi"

/ {
	model = "Qualcomm Technologies, Inc. KHAJEP IDP";
	compatible = "qcom,khajep-idp", "qcom,khajep", "qcom,idp";
	qcom,board-id = <0x10022 0>;
	qcom,pmic-id = <0x2D 0x2E 0x0 0x0>;
};

/dts-v1/;

#include "sdm660.dtsi"
#include "sdm660-cdp.dtsi"
#include "msm-pm660a.dtsi"
#include "sdm660-external-codec.dtsi"

/ {
	model = "Qualcomm Technologies, Inc. SDM 660 PM660 + PM660A, Headset
		Jacktype NO, RCM";
	compatible = "qcom,sdm660-cdp", "qcom,sdm660", "qcom,cdp";
	qcom,board-id = <21 2>;
	qcom,pmic-id = <0x0001001b 0x0001011a 0x0 0x0>;
};

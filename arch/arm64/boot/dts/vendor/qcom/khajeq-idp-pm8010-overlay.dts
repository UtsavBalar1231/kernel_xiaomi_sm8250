/dts-v1/;
/plugin/;

#include <dt-bindings/interrupt-controller/arm-gic.h>
#include "khajeq-idp.dtsi"
#include "khajeq-idp-pm8010.dtsi"

/ {
	model = "Qualcomm Technologies, Inc. Khajeq IDP with PM8010";
	compatible = "qcom,khajeq-idp", "qcom,khajeq", "qcom,idp";
	qcom,msm-id = <562 0x10000>;
	qcom,board-id = <0x10222 0>;
	qcom,pmic-id = <0x2D 0x2E 0x0 0x0>;
};


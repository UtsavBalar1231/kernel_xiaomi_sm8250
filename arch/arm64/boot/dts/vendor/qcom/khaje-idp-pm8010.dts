/dts-v1/;

#include "khaje.dtsi"
#include "khaje-idp.dtsi"
#include "khaje-idp-pm8010.dtsi"

/ {
	model = "Qualcomm Technologies, Inc. KHAJE IDP with PM8010";
	compatible = "qcom,khaje-idp", "qcom,khaje", "qcom,idp";
	qcom,board-id = <0x10222 0>;
	qcom,pmic-id = <0x02D 0x2E 0x0 0x0>;
};


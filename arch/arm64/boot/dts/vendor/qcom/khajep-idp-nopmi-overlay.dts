/dts-v1/;
/plugin/;

#include <dt-bindings/interrupt-controller/arm-gic.h>
#include "khajep-idp-nopmi.dtsi"

/ {
	model = "Qualcomm Technologies, Inc. KHAJEP IDP nopmi";
	compatible = "qcom,khajep-idp", "qcom,khajep", "qcom,idp";
	qcom,msm-id = <561 0x10000>;
	qcom,board-id = <0x10022 0>;
	qcom,pmic-id = <0x2D 0x0 0x0 0x0>;
};

## drivers/fragmention/Kconfig
```kconfig
config MI_FRAGMENTION
        bool "Xiaomi memory fragmention test"
        default n
        help
	    Say Y to enable MIUI Memory fragmentize simulate test
```

## drivers/hwtracing/Kconfig
```kconfig
menu "HW tracing support"

source "drivers/hwtracing/stm/Kconfig"

source "drivers/hwtracing/intel_th/Kconfig"

source "drivers/hwtracing/google/Kconfig"

endmenu
```

## drivers/input/misc/aw8697_haptic_new/Kconfig
```kconfig
#
# Awinic aw8697 driver
#

config INPUT_AW8697_HAPTIC_NEW
	tristate "Awinic AW8697 HAPTIC"
	depends on I2C && !INPUT_AW8697_HAPTIC
	help
	  Say Y here if you have Awinic AW8697 haptic controller
	  chip in your system.

	  If unsure, say N.

	  To compile this driver as a module, choose M here.
```

## drivers/mihw/Kconfig
```kconfig
config MIGT
	bool "boost cpufreq when load high"
	depends on MIHW
	help
	  Boost cpufreq when current frame drawing time too long

config MILLET
	bool "frozen framework"
	depends on MIHW
	help
	  Mi frozen function

config MIGT_ENERGY_MODEL
	bool "DT-based Energy Model for CPU and gpu"
	depends on MIHW
	help
	  This mod rely on Energy Models (EMs) statically defined in
	  the Device Tree. Since EAS now uses only the active costs of CPUs,
	  the cluster-related costs and idle-costs are ignored.
```

## drivers/staging/cam-reclaim/Kconfig
```kconfig
config CAM_RECLAIM
	bool "reclaim pages under camera condition"
	depends on MIHW
	default n
```

## drivers/staging/mi-reclaim/Kconfig
```kconfig
config MI_RECLAIM
	bool "reclaim pages"
	depends on MIHW
	default n
	---help---
	  Mi memory reclaim
```

## techpack/data/drivers/emac-dwc-eqos/Kconfig
```kconfig
#
# Synopsis EMAC device configuration
#

config EMAC_DWC_EQOS
	tristate "Qualcomm Technologies Inc. EMAC support"
	depends on (ARM || ARM64)
	default y
	help
	  This driver supports the Synopsis EMAC Gigabit
	  Ethernet controller.
```

## techpack/data/drivers/rmnet/Kconfig
```kconfig
source "techpack/data/drivers/rmnet/perf/Kconfig"
source "techpack/data/drivers/rmnet/shs/Kconfig"
```

## techpack/data/drivers/rmnet/perf/Kconfig
```kconfig
#
# RMNET_PERF driver
#

config RMNET_PERF
	tristate "Rmnet Perf driver"
	default m
	depends on RMNET
	---help---
	  performance mode of rmnet driver
```

## techpack/data/drivers/rmnet/shs/Kconfig
```kconfig
#
# RMNET_SHS driver
#

config RMNET_SHS
	tristate "Rmnet SHS driver"
	default m
	depends on RMNET
	---help---
	  performance mode of rmnet driver
```

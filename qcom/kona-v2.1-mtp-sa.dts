/dts-v1/;

#include "kona-v2.1.dtsi"
#include "kona-mtp.dtsi"

/ {
	model = "Qualcomm Technologies, Inc. kona v2.1 standalone MTP";
	compatible = "qcom,kona-mtp", "qcom,kona", "qcom,mtp";
	qcom,board-id = <0x02010008 0>;
};

&mdm0 {
	status = "disabled";
};

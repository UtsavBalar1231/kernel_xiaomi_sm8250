/dts-v1/;

#include "sdm660.dtsi"

/ {
	model = "Qualcomm Technologies, Inc. SDM 660 PM660L SoC";
	compatible = "qcom,sdm660";
	qcom,pmic-id = <0x0001001b 0x0101011a 0x0 0x0>,
			<0x0001001b 0x0201011a 0x0 0x0>,
			<0x0001001b 0x0102001a 0x0 0x0>;
};

/dts-v1/;

#include "khajep.dtsi"
#include "khajep-idp.dtsi"
#include "khaje-idp-pm7250b.dtsi"
#include "khajep-idp-usbc.dtsi"

/ {
	model = "Qualcomm Technologies, Inc. KHAJEP IDP USBC Audio";
	compatible = "qcom,khajep-idp", "qcom,khajep", "qcom,idp";
	qcom,msm-id = <561 0x10000>;
	qcom,board-id = <0x1010022 0>;
	qcom,pmic-id = <0x2D 0x2E 0x0 0x0>;
};


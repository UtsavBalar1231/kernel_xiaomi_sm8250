&soc {
	mdss_dsi0_pll: qcom,mdss_dsi0_pll {
		compatible = "qcom,mdss_dsi_pll_7nm_v4_1";
		label = "MDSS DSI 0 PLL";
		cell-index = <0>;
		#clock-cells = <1>;
		reg = <0x5e94900 0x264>,
		      <0x5e94400 0x800>,
		      <0x5f01004 0x8>,
		      <0x5e94200 0x100>;
		reg-names = "pll_base", "phy_base",
			"gdsc_base", "dynamic_pll_base";
		clocks = <&dispcc DISP_CC_MDSS_AHB_CLK>;
		clock-names = "iface_clk";
		clock-rate = <0>;
		memory-region = <&dfps_data_memory>;
		qcom,dsi-pll-ssc-en;
		qcom,dsi-pll-ssc-mode = "down-spread";
	};
};

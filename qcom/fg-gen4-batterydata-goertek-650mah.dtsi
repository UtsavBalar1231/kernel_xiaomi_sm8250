qcom,5376013_goertek_oracle_650mah_pm8150b_sept23rd2021 {
	/* #5376013_Goertek_Oracle_650mAH_averaged_MasterSlave_Sept23rd2021*/
	qcom,max-voltage-uv = <4480000>;
	qcom,fg-cc-cv-threshold-mv = <4470>;
	qcom,nom-batt-capacity-mah = <650>;
	qcom,batt-id-kohm = <100>;
	qcom,battery-beta = <4250>;
	qcom,therm-room-temp = <100000>;
	qcom,battery-type = "goertek_oracle_650mah_pm8150b_sept23rd2021";
	qcom,therm-coefficients = <0x2318 0xd0c 0xdaf7 0xc556 0x848d>;
	qcom,therm-center-offset = <0x70>;
	qcom,therm-pull-up = <100>;
	qcom,rslow-normal-coeffs = <0x3b 0xf2 0x34 0x0b>;
	qcom,rslow-low-coeffs = <0x3f 0x0d 0x0c 0xea>;
	qcom,checksum = <0x4B53>;
	qcom,gui-version = "PM855GUI - 1.0.0.14";
	qcom,fg-profile-data = [
		 09 00 2F 01
		 F8 05 9C 03
		 0F FC 00 00
		 3D CC 0D A2
		 CC 87 E0 C2
		 F1 C5 80 87
		 52 00 3B F2
		 34 0B FE D5
		 9A E2 CE 07
		 32 00 6E F2
		 15 E2 4A E2
		 62 13 97 F2
		 FA C5 F1 1A
		 15 07 DE CD
		 60 00 42 00
		 40 00 3E 00
		 39 00 3D 00
		 3C 00 41 00
		 51 00 54 00
		 4C 00 60 00
		 34 00 3F 00
		 40 00 38 00
		 44 00 36 00
		 61 64 4A 00
		 3B E8 3E 00
		 60 F0 21 00
		 28 08 23 18
		 30 18 3D 00
		 2A 18 53 40
		 30 58 2A 07
		 33 00 D8 00
		 6F 1C 14 0B
		 1C 02 59 0D
		 6E 19 D9 13
		 4E 0D 1E 1B
		 B6 18 43 33
		 78 3D 80 03
		 4F 1B 3C 1F
		 2A 05 63 0B
		 30 05 C3 19
		 85 0A EC 0D
		 6B 0B C4 17
		 68 1A C5 2D
		 60 3B 85 20
		 ED 1E 75 F5
		 3E F3 40 F5
		 FE 19 3D EA
		 97 04 D5 CA
		 E3 17 1E A2
		 BA 84 0E CA
		 87 C0 09 80
		 B6 03 29 FD
		 B7 03 1C 05
		 00 F8 87 E4
		 04 D2 CB DF
		 50 E2 8D CC
		 E4 25 30 00
		 E8 E6 85 02
		 EF 06 7E 00
		 CE 07 32 00
		 15 03 56 02
		 C3 05 C9 05
		 62 04 42 02
		 C4 02 49 01
		 EB 05 60 00
		 39 00 46 00
		 47 64 4B 00
		 52 08 53 10
		 52 08 51 00
		 50 00 3F 08
		 60 08 54 00
		 5B 20 5B 38
		 58 48 6B 15
		 74 00 5E 08
		 6B 10 60 00
		 6C 00 60 00
		 77 08 69 08
		 70 00 5F 20
		 73 38 7E 48
		 60 18 6F 00
		 72 08 8B 10
		 D8 08 7F 23
		 9F 04 F1 02
		 83 05 E1 1C
		 27 22 DF 3D
		 4E 4A C7 18
		 7B 02 65 04
		 A4 03 8E 17
		 3F 0A 8C 21
		 99 05 4E 02
		 25 04 9A 1C
		 3B 02 F0 05
		 4A 02 C4 18
		 0F 02 69 05
		 49 02 87 00
		 38 22 36 05
		 9E 02 C3 05
		 65 1C 21 02
		 D7 04 89 03
		 B0 18 07 02
		 67 05 59 02
		 91 00 10 03
		 C0 00 FA 00
		 93 02 00 00
	];
};

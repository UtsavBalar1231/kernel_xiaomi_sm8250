/dts-v1/;

#include "bengal.dtsi"
#include "bengal-idp.dtsi"
#include "bengal-thermal-pmi632-overlay.dtsi"
#include "bengal-idp-pmi632.dtsi"

/ {
	model = "Qualcomm Technologies, Inc. BENGAL IDP";
	compatible = "qcom,bengal-idp", "qcom,bengal", "qcom,idp";
	qcom,board-id = <34 0>;
	qcom,pmic-id = <0x2D 0x25 0x0 0x0>;
};

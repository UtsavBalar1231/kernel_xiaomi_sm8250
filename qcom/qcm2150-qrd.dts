/dts-v1/;

#include "qcm2150.dtsi"
#include "qcm2150-qrd.dtsi"

/ {
	model = "Qualcomm Technologies, Inc. QCM2150 QRD";
	compatible = "qcom,qcm2150-qrd", "qcom,qcm2150", "qcom,qrd";
	qcom,board-id = <0x01000b 4>;
	qcom,pmic-id = <0x010016 0x25 0x0 0x0>;
};

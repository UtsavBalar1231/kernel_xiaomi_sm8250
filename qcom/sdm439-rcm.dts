/dts-v1/;

#include "sdm439.dtsi"
#include "sdm439-rcm.dtsi"

/ {
	model = "Qualcomm Technologies, Inc. SDM439 RCM";
	compatible = "qcom,sdm439-cdp", "qcom,sdm439", "qcom,cdp";
	qcom,board-id = <21 1>;
	qcom,pmic-id = <0x010016 0x25 0x0 0x0>;
};

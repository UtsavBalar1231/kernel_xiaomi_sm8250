/dts-v1/;
/plugin/;

#include <dt-bindings/interrupt-controller/arm-gic.h>
#include "scuba-iot-rb1.dtsi"

/ {
	model = "Qualcomm Technologies, Inc. Scuba IOT RB1";
	compatible = "qcom,scuba-qrd", "qcom,scuba-iot", "qcom,qrd";
	qcom,msm-id = <474 0x10000>;
	qcom,board-id = <0x1000B 1>;
};

/dts-v1/;

#include "scuba.dtsi"
#include "scuba-idp.dtsi"

/ {
	model = "Qualcomm Technologies, Inc. Scubap IDP";
	compatible = "qcom,scuba-idp", "qcom,scuba", "qcom,idp";
	qcom,msm-id = <471 0x10000>;
	qcom,board-id = <34 0>;
};

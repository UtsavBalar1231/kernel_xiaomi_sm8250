/dts-v1/;

#include "kona.dtsi"
#include "kona-arglass.dtsi"

/ {
	model = "Qualcomm Technologies, Inc. kona AR Glass";
	compatible = "qcom,kona-mtp", "qcom,kona", "qcom,mtp";
	qcom,board-id = <0x1040008 0>;
};

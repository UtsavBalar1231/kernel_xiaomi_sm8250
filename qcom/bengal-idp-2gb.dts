/dts-v1/;

#include "bengal-low-ram.dtsi"
#include "bengal-idp-low-ram.dtsi"

/ {
	model = "Qualcomm Technologies, Inc. BENGAL IDP 2Gb DDR HD+";
	compatible = "qcom,bengal-idp", "qcom,bengal", "qcom,idp";
	qcom,board-id = <34 0x403>;
};

/dts-v1/;

#include "litomagnus.dtsi"
#include "litomagnus-mtp.dtsi"
#include "lito-v2-audio.dtsi"

/ {
	model = "Qualcomm Technologies, Inc. Litomagnus MTP";
	compatible = "qcom,lito-mtp", "qcom,lito", "qcom,mtp";
	qcom,board-id = <8 1>;
};

&ufsphy_mem {
	/delete-property/ vdda-phy-always-on;
};

#include "khaje-pm7250b.dtsi"

&sde_dsi {
	pinctrl-0 = <&sde_dsi_active &sde_te_active &disp_lcd_bias_en_default>;
};

&dsi_td4330_truly_v2_video {
	qcom,platform-en-gpio = <&pm7250b_gpios 5 0>;
	qcom,platform-bklight-en-gpio = <&pm7250b_gpios 1 0>;
};

&dsi_td4330_truly_v2_cmd {
	qcom,platform-en-gpio = <&pm7250b_gpios 5 0>;
	qcom,platform-bklight-en-gpio = <&pm7250b_gpios 1 0>;
};

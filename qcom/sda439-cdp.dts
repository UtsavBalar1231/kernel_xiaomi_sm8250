/dts-v1/;

#include "sda439.dtsi"
#include "sdm439-cdp.dtsi"

/ {
	model = "Qualcomm Technologies, Inc. SDA439 CDP";
	compatible = "qcom,sda439-cdp", "qcom,sda439", "qcom,cdp";
	qcom,board-id = <1 2>;
	qcom,pmic-id = <0x010016 0x25 0x0 0x0>;
};

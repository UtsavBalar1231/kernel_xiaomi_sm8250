#include "bengal.dtsi"

/ {
	model = "Qualcomm Technologies, Inc. QCS4290";
	compatible = "qcom,qcs4290";
	qcom,msm-id = <470 0x0>;
	qcom,msm-name = "QCS4290";
};

&soc {
	qcom,rmnet-ipa {
		status = "disabled";
	};
};

&ipa_hw {
	status = "disabled";
};

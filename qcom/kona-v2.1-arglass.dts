/dts-v1/;

#include "kona-v2.1.dtsi"
#include "kona-arglass.dtsi"

/ {
	model = "Qualcomm Technologies, Inc. kona v2.1 AR Glass";
	compatible = "qcom,kona-mtp", "qcom,kona", "qcom,mtp";
	qcom,board-id = <0x1040008 0>;
};

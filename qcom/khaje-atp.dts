/dts-v1/;

#include "khaje.dtsi"
#include "khaje-atp.dtsi"

/ {
	model = "Qualcomm Technologies, Inc. Khaje ATP";
	compatible = "qcom,khaje-atp", "qcom,khaje", "qcom,atp";
	qcom,board-id = <33 0>;
};


/dts-v1/;

#include "qcm4290.dtsi"
#include "qcm4290-iot-idp.dtsi"

/ {
	model = "Qualcomm Technologies, Inc. QCM4290 IOT IDP";
	compatible = "qcom,qcm4290-idp", "qcom,qcm4290", "qcom,idp";
	qcom,board-id = <34 0>;
};

/dts-v1/;
/plugin/;

#include <dt-bindings/interrupt-controller/arm-gic.h>
#include "qcs4290-iot-idp.dtsi"

/ {
	model = "Qualcomm Technologies, Inc. QCS4290 IOT IDP Overlay";
	compatible = "qcom,qcs4290-idp", "qcom,qcs4290", "qcom,idp";
	qcom,msm-id = <470 0x10000>;
	qcom,board-id = <34 0>;
};

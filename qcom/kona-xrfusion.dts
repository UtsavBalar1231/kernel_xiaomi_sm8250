/dts-v1/;

#include "kona.dtsi"
#include "kona-xrfusion.dtsi"

/ {
	model = "Qualcomm Technologies, Inc. kona XR 5G Fusion";
	compatible = "qcom,kona-mtp", "qcom,kona", "qcom,mtp";
	qcom,board-id = <0x1020008 0>;
};

/dts-v1/;

#include "khajeq.dtsi"
#include "khajeq-qrd.dtsi"
#include "khaje-qrd-pm7250b.dtsi"
#include "khajeq-qrd-hvdcp3p5.dtsi"

/ {
	model = "Qualcomm Technologies, Inc. KHAJEQ QRD HVDCP3P5";
	compatible = "qcom,khajeq-qrd", "qcom,khajeq", "qcom,qrd";
	qcom,board-id = <0x1010B 0>;
	qcom,pmic-id = <0x2D 0x2E 0x0 0x0>;
};

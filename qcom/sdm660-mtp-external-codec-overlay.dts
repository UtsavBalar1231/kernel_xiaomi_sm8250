/dts-v1/;
/plugin/;

#include <dt-bindings/clock/qcom,cpu-osm.h>
#include <dt-bindings/clock/qcom,rpmcc.h>
#include <dt-bindings/clock/qcom,mmcc-sdm660.h>
#include <dt-bindings/regulator/qcom,rpm-smd-regulator.h>
#include <dt-bindings/interrupt-controller/arm-gic.h>

#include "sdm660-mtp.dtsi"
#include "sdm660-external-codec.dtsi"

/ {
	model = "Qualcomm Technologies, Inc. SDM 660 Ext. Audio Codec MTP";
	compatible = "qcom,sdm660-mtp", "qcom,sdm660", "qcom,mtp";
	qcom,board-id = <8 0>;
};

&tavil_snd {
	qcom,msm-mbhc-moist-cfg = <0>, <0>, <3>;
};

&slim_aud {
	/delete-node/tasha_codec;
};

&soc {
	/delete-node/sound-9335;
};


/dts-v1/;
/plugin/;

#include <dt-bindings/interrupt-controller/arm-gic.h>
#include "khajeq-idp.dtsi"
#include "khaje-idp-pm7250b.dtsi"
#include "khajeq-idps-display-90hz.dtsi"

/ {
	model = "Qualcomm Technologies, Inc. KHAJEQ IDPS + 90Hz";
	compatible = "qcom,khajeq-idp", "qcom,khajeq", "qcom,idp";
	qcom,msm-id = <562 0x10000>;
	qcom,board-id = <0x10122 0>;
	qcom,pmic-id = <0x2D 0x2E 0x0 0x0>;
};

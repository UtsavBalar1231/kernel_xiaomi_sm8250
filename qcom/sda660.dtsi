#include "sdm660.dtsi"

/ {
	model = "Qualcomm Technologies, Inc. SDA 660";
	compatible = "qcom,sda660";
	qcom,msm-id = <324 0x0>;
};

&soc {
	qcom,rmnet-ipa {
		status = "disabled";
	};
};

&ipa_hw {
	status = "disabled";
};

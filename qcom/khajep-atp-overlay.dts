/dts-v1/;
/plugin/;

#include <dt-bindings/interrupt-controller/arm-gic.h>
#include "khajep-atp.dtsi"

/ {
	model = "Qualcomm Technologies, Inc. Khajep ATP";
	compatible = "qcom,khajep-atp", "qcom,khajep", "qcom,atp";
	qcom,msm-id = <561 0x10000>;
	qcom,board-id = <33 0>;
	qcom,pmic-id = <0x2D 0x2E 0x0 0x0>;
};


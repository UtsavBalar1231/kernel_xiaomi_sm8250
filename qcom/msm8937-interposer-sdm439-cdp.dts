/dts-v1/;

#include "msm8937-interposer-sdm439.dtsi"
#include "sdm439-cdp.dtsi"

/ {
	model = "Qualcomm Technologies, Inc. MSM8937 Interposer SDM439 CDP";
	compatible = "qcom,msm8937-cdp", "qcom,msm8937", "qcom,cdp";
	qcom,board-id = <1 2>;
	qcom,pmic-id = <0x010016 0x25 0x0 0x0>;
};

/dts-v1/;

#include "sdm660.dtsi"
#include "sdm660-cdp.dtsi"
#include "msm-pm660a.dtsi"
#include "sdm660-internal-codec.dtsi"

/ {
	model = "Qualcomm Technologies, Inc. SDM 660 PM660 + PM660A Int. Audio
		Codec RCM";
	compatible = "qcom,sdm660-cdp", "qcom,sdm660", "qcom,cdp";
	qcom,board-id = <21 1>;
	qcom,pmic-id = <0x0001001b 0x0001011a 0x0 0x0>;
};

/dts-v1/;
/plugin/;

#include <dt-bindings/interrupt-controller/arm-gic.h>
#include "orchid-cdp.dtsi"
#include "lito-v2-audio.dtsi"

/ {
	model = "Qualcomm Technologies, Inc. Orchid CDP";
	compatible = "qcom,orchid-cdp", "qcom,orchid", "qcom,cdp";
	qcom,msm-id = <476 0x10000>;
	qcom,board-id = <1 1>;
};

/*
 * overriding adsp-fw-names with empty string
 * to allow default adsp img load
 */
&adsp_loader {
	adsp-fw-names="";
};

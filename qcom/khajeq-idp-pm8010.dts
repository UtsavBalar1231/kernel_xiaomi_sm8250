/dts-v1/;

#include "khajeq.dtsi"
#include "khajeq-idp.dtsi"
#include "khajeq-idp-pm8010.dtsi"

/ {
	model = "Qualcomm Technologies, Inc. KHAJEQ IDP with PM8010";
	compatible = "qcom,khajeq-idp", "qcom,khajeq", "qcom,idp";
	qcom,board-id = <0x10222 0>;
	qcom,pmic-id = <0x02D 0x2E 0x0 0x0>;
};


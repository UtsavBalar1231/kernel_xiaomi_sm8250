/dts-v1/;
/plugin/;

#include <dt-bindings/interrupt-controller/arm-gic.h>
#include "khaje-idp.dtsi"
#include "khaje-idp-pm8010.dtsi"

/ {
	model = "Qualcomm Technologies, Inc. Khaje IDP with PM8010";
	compatible = "qcom,khaje-idp", "qcom,khaje", "qcom,idp";
	qcom,msm-id = <518 0x10000>;
	qcom,board-id = <0x10222 0>;
	qcom,pmic-id = <0x2D 0x2E 0x0 0x0>;
};


/dts-v1/;

#include "qm215.dtsi"
#include "qm215-pm8916.dtsi"
/* TBD */
/* #include "qm215-audio.dtsi" */

/ {
	model = "Qualcomm Technologies, Inc. QM215";
	compatible = "qcom,qm215";
	qcom,pmic-name = "PM8916";
};

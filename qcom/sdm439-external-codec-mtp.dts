/dts-v1/;

#include "sdm439.dtsi"
#include "sdm439-mtp.dtsi"
#include "sdm439-external-codec.dtsi"

/ {
	model = "Qualcomm Technologies, Inc. SDM439 Audio Codec MTP";
	compatible = "qcom,sdm439-mtp", "qcom,sdm439", "qcom,mtp";
	qcom,board-id = <8 3>;
	qcom,pmic-id = <0x010016 0x25 0x0 0x0>;
};

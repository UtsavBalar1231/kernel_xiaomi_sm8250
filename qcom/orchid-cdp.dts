/dts-v1/;

#include "orchid.dtsi"
#include "orchid-cdp.dtsi"
#include "lito-v2-audio.dtsi"

/ {
	model = "Qualcomm Technologies, Inc. Orchid CDP";
	compatible = "qcom,orchid-cdp", "qcom,orchid", "qcom,cdp";
	qcom,board-id = <1 0>;
};

&ufsphy_mem {
	/delete-property/ vdda-phy-always-on;
};

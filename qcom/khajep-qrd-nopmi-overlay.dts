/dts-v1/;
/plugin/;

#include <dt-bindings/interrupt-controller/arm-gic.h>
#include "khajep-qrd-nopmi.dtsi"

/ {
	model = "Qualcomm Technologies, Inc. KHAJEP QRD nopmi overlay";
	compatible = "qcom,khajep-qrd", "qcom,khajep", "qcom,qrd";
	qcom,msm-id = <561 0x10000>;
	qcom,board-id = <0x1000B 0>;
	qcom,pmic-id = <0x2D 0x0 0x0 0x0>;
};

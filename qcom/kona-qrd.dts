/dts-v1/;

#include "kona.dtsi"
#include "kona-qrd.dtsi"

/ {
	model = "Qualcomm Technologies, Inc. kona QRD";
	compatible = "qcom,kona-qrd", "qcom,kona", "qcom,qrd";
	qcom,board-id = <11 0>;
};

&sdhc_2 {
	cd-gpios = <&tlmm 77 GPIO_ACTIVE_LOW>;
};

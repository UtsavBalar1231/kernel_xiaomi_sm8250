&mdss_mdp {
	dsi_dual_arglass_seeya_video: qcom,mdss_dsi_arglass_seeya_video {
	qcom,mdss-dsi-panel-name =
		"sy049wdm02 uoled video mode dsi seeya 60Hz panel";
	qcom,mdss-dsi-panel-type = "dsi_video_mode";
	qcom,dsi-ctrl-num = <0 1>;
	qcom,dsi-phy-num = <0 1>;

	qcom,mdss-dsi-virtual-channel-id = <0>;
	qcom,mdss-dsi-stream = <0>;
	qcom,mdss-dsi-bpp = <24>;
	qcom,mdss-dsi-border-color = <0>;
	qcom,mdss-dsi-traffic-mode = "non_burst_sync_event";
	qcom,mdss-dsi-bllp-eof-power-mode;
	qcom,mdss-dsi-bllp-power-mode;
	qcom,mdss-dsi-lane-0-state;
	qcom,mdss-dsi-lane-1-state;
	qcom,mdss-dsi-lane-2-state;
	qcom,mdss-dsi-lane-3-state;
	qcom,mdss-dsi-dma-trigger = "trigger_sw";
	qcom,mdss-dsi-mdp-trigger = "none";
	qcom,mdss-dsi-reset-sequence = <1 20>, <0 20>, <1 50>;
	qcom,adjust-timer-wakeup-ms = <1>;
	qcom,mdss-dsi-panel-hdr-enabled;
	qcom,mdss-dsi-panel-hdr-color-primaries = <14500 15500 32000
		17000 15500 30000 8000 3000>;
	qcom,mdss-dsi-panel-peak-brightness = <4200000>;
	qcom,mdss-dsi-panel-blackness-level = <3230>;

	qcom,mdss-dsi-display-timings {
		timing@0 {
			qcom,mdss-dsi-panel-width = <1920>;
			qcom,mdss-dsi-panel-height = <1080>;
			qcom,mdss-dsi-h-front-porch = <88>;
			qcom,mdss-dsi-h-back-porch = <148>;
			qcom,mdss-dsi-h-pulse-width = <44>;
			qcom,mdss-dsi-h-sync-skew = <0>;
			qcom,mdss-dsi-v-back-porch = <36>;
			qcom,mdss-dsi-v-front-porch = <5>;
			qcom,mdss-dsi-v-pulse-width = <5>;
			qcom,mdss-dsi-h-left-border = <0>;
			qcom,mdss-dsi-panel-framerate = <60>;
			qcom,mdss-dsi-on-command = [
				39 01 00 00 00 00 02 53 29
				39 01 00 00 00 00 03 51 FF 01
				39 01 00 00 00 00 02 03 00
				39 01 00 00 00 00 07 80 00 E0 E0 0E 00 31
				39 01 00 00 00 00 08 81 03 04 00 29 00 05 00
				39 01 00 00 00 00 08 82 03 04 00 29 00 05 01
				39 01 00 00 00 00 02 35 00
				39 01 00 00 00 00 02 26 20
				/* CMD2 P1 */
				39 01 00 00 00 00 03 F0 AA 11
				39 01 00 00 00 00 02 C0 00
				39 01 00 00 00 00 0C C2 01 32 01 32 01 32 01 32 02 00 00
				/* CMD2 P2 */
				39 01 00 00 00 00 03 F0 AA 12
				39 01 00 00 00 00 03 BF 37 A9
				/* H mirror dsi1 */
				39 01 00 00 00 00 03 FF 5A 80
				39 01 00 00 00 00 02 65 2F
				39 01 00 00 00 00 02 F2 01
				39 01 00 00 00 00 02 36 02
				/* V mirror dsi0 */
				39 01 00 04 00 00 03 FF 5A 80
				39 01 00 04 00 00 02 65 2F
				39 01 00 04 00 00 02 F2 01
				39 01 00 04 00 00 02 36 01
				39 01 00 04 00 00 03 F0 AA 13
				39 01 00 04 00 00 02 65 01
				39 01 00 04 00 00 02 C1 A2
				39 01 00 04 00 00 07 C4 12 53 64 31 42 56
				39 01 00 04 00 00 03 F0 AA 16
				39 01 00 04 00 00 07 B6 12 53 64 31 42 56
				39 01 00 04 00 00 03 B0 00 55
				/* CMD3 P0 */
				39 01 00 00 00 00 03 FF 5A 80
				39 01 00 00 00 00 02 65 2F
				39 01 00 00 00 00 02 F2 01
				/* CMD3 P1 */
				39 01 00 00 00 00 03 FF 5A 81
				39 01 00 00 00 00 02 65 05
				39 01 00 00 00 00 02 F2 22
				39 01 00 00 00 00 02 65 0A
				39 01 00 00 00 00 02 F2 00
				39 01 00 00 00 00 02 65 16
				39 01 00 00 00 00 0F F9 01 5F 61 64 67 6A 6D 6F 75 7B 80 86 8B 91
				05 01 00 00 cb 00 02 11 00
				05 01 00 00 00 00 02 29 00
				39 01 00 00 00 00 03 F0 AA 11
			];
			qcom,mdss-dsi-off-command = [05 01 00 00 0a 00
				02 28 00 05 01 00 00 3c 00 02 10 00];

			qcom,mdss-dsi-on-command-state = "dsi_lp_mode";
			qcom,mdss-dsi-off-command-state = "dsi_hs_mode";
			};
		};
	};
};

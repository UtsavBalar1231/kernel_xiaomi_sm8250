/dts-v1/;

#include "sda439.dtsi"
#include "sdm439-mtp.dtsi"

/ {
	model = "Qualcomm Technologies, Inc. SDA439 MTP";
	compatible = "qcom,sda439-mtp", "qcom,sda439", "qcom,mtp";
	qcom,board-id = <8 1>;
	qcom,pmic-id = <0x010016 0x25 0x0 0x0>;
};

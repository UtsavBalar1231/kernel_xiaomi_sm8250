/dts-v1/;

#include "kona.dtsi"
#include "kona-mtp.dtsi"

/ {
	model = "Qualcomm Technologies, Inc. kona standalone MTP";
	compatible = "qcom,kona-mtp", "qcom,kona", "qcom,mtp";
	qcom,board-id = <0x02010008 0>;
};

&mdm0 {
	status = "disabled";
};

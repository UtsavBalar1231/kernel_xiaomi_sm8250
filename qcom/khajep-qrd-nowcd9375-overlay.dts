/dts-v1/;
/plugin/;

#include <dt-bindings/interrupt-controller/arm-gic.h>
#include "khajep-qrd.dtsi"
#include "khaje-qrd-pm7250b.dtsi"
#include "khajep-qrd-nowcd9375.dtsi"

/ {
	model = "Qualcomm Technologies, Inc. Khajep QRD NOWCD9375";
	compatible = "qcom,khajep-qrd", "qcom,khajep", "qcom,qrd";
	qcom,msm-id = <561 0x10000>;
	qcom,board-id = <0x2010B 0>;
	qcom,pmic-id = <0x2D 0x2E 0x0 0x0>;
};

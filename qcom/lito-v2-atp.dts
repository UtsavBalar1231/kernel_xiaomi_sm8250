/dts-v1/;

#include "lito-v2.dtsi"
#include "lito-atp.dtsi"
#include "lito-v2-audio.dtsi"

/ {
	model = "Qualcomm Technologies, Inc. Lito ATP";
	compatible = "qcom,lito-atp", "qcom,lito", "qcom,atp";
	qcom,board-id = <33 0>;
};

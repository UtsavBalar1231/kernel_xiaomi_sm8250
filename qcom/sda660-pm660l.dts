/dts-v1/;

#include "sda660.dtsi"

/ {
	model = "Qualcomm Technologies, Inc. SDA 660 PM660L SoC";
	compatible = "qcom,sda660";
	qcom,pmic-id = <0x0001001b 0x0101011a 0x0 0x0>,
			<0x0001001b 0x0201011a 0x0 0x0>,
			<0x0001001b 0x0102001a 0x0 0x0>;
};

/dts-v1/;

#include "qm215.dtsi"
#include "qm215-pm8916.dtsi"
#include "qm215-qrd.dtsi"

/ {
	model = "Qualcomm Technologies, Inc. qm215 QRD";
	compatible = "qcom,qm215-qrd", "qcom,qm215", "qcom,qrd";
	qcom,board-id = <0x01000b 4>;
	qcom,pmic-id = <0x010016 0x25 0x0 0x0>;
};

/dts-v1/;

#include "scuba-iot-low-ram.dtsi"
#include "scubalite-iot-idp.dtsi"

/ {
	model = "Qualcomm Technologies, Inc. Scuba IOT 2GB DDR SoC";
	compatible = "qcom,scuba-iot";
	qcom,msm-id = <473 0x10000>;
	qcom,board-id = <34 0x3>;
};

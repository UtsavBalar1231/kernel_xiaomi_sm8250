/dts-v1/;

#include "lito-v2.dtsi"
#include "lito-cdp.dtsi"

/ {
	model = "Qualcomm Technologies, Inc. Lito CDP";
	compatible = "qcom,lito-cdp", "qcom,lito", "qcom,cdp";
	qcom,board-id = <1 0>;
};

&lpi_tlmm {
	qcom,tx_data3_enabled = <1>;
	qcom,tx_data3_addr = <0x0355C000>;
	qcom,swr_tx_data3_val = <0x3>;
};

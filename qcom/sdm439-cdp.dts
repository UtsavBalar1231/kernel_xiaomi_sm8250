/dts-v1/;

#include "sdm439.dtsi"
#include "sdm439-cdp.dtsi"

/ {
	model = "Qualcomm Technologies, Inc. SDM439 CDP";
	compatible = "qcom,sdm439-cdp", "qcom,sdm439", "qcom,cdp";
	qcom,board-id = <1 2>;
	qcom,pmic-id = <0x010016 0x25 0x0 0x0>;
};

/dts-v1/;

#include "sdm439.dtsi"
#include "sdm439-qrd.dtsi"

/ {
	model = "Qualcomm Technologies, Inc. SDM439 QRD";
	compatible = "qcom,sdm439-qrd", "qcom,sdm439", "qcom,qrd";
	qcom,board-id = <0xb 2>;
	qcom,pmic-id = <0x010016 0x25 0x0 0x0>;
};
